## bsp/cvitek/c920_big/Kconfig
```kconfig
mainmenu "RT-Thread Project Configuration"

BSP_DIR := .

RTT_DIR := ../../..

PKGS_DIR := packages

source "$(RTT_DIR)/Kconfig"
source "$PKGS_DIR/Kconfig"
source "board/Kconfig"

# 定义整个BSP形态
config BSP_USING_SG2260
    bool
    select ARCH_RISCV64
    select ARCH_RISCV_FPU_D
    select ARCH_USING_RISCV_COMMON64
    select RT_USING_SYSTEM_WORKQUEUE
    select RT_USING_COMPONENTS_INIT
    select RT_USING_USER_MAIN
    select RT_USING_CACHE
    select ARCH_MM_MMU
    select RT_USING_DEVICE_OPS
    select ARCH_REMAP_KERNEL if RT_USING_SMART
    default y

config C920_PLIC_PHY_ADDR
    hex
    default 0x6E00000000 if SOC_TYPE_BM1690_AP
    default 0x690c800000 if SOC_TYPE_BM1690_TP

# 添加 TPU_INDEX 配置项
config TPU_INDEX
    int "TPU index(0: default )"
    depends on SOC_TYPE_BM1690_TP
    range 0 7
    default 0
    help
      Select the TPU number to adjust the boot address.
      TPU_FW_OFFSET is 0x20000000ULL

config C920_BOOT_ADDR
    hex
    default 0x80200000 if SOC_TYPE_BM1690_AP && BOOT_TYPE_FROM_SOC
    default 0x1EA0200000 if SOC_TYPE_BM1690_AP && BOOT_TYPE_FROM_PCIE
    default 0x1F00200000 if SOC_TYPE_BM1690_TP && TPU_INDEX = 0
    default 0x1F20200000 if SOC_TYPE_BM1690_TP && TPU_INDEX = 1
    default 0x1F40200000 if SOC_TYPE_BM1690_TP && TPU_INDEX = 2
    default 0x1F60200000 if SOC_TYPE_BM1690_TP && TPU_INDEX = 3
    default 0x1F80200000 if SOC_TYPE_BM1690_TP && TPU_INDEX = 4
    default 0x1FA0200000 if SOC_TYPE_BM1690_TP && TPU_INDEX = 5
    default 0x1FC0200000 if SOC_TYPE_BM1690_TP && TPU_INDEX = 6
    default 0x1FE0200000 if SOC_TYPE_BM1690_TP && TPU_INDEX = 7

config TOTAL_MEMORY
    hex "total memory used"
    default  0x2000000

config IRQ_MAX_NR
    int
    default 512

config BSP_GPIO_IRQ_BASE
    int
    default 26

config __STACKSIZE__
    int "stack size for interrupt"
    default 4096

# 定义里面SOC对应的形态
config SOC_TYPE_BM1690_AP
    bool
    select ARCH_RISCV_VECTOR
    default n

config SOC_TYPE_BM1690_RP
    bool
    default n

config SOC_TYPE_BM1690_TP
    bool
    default n

choice
    prompt "Board Type"
    default BOARD_TYPE_SOPHGO_BM1690_AP

	#定义板卡形态，是AP/RP/TP
    config BOARD_TYPE_SOPHGO_BM1690_AP
		select SOC_TYPE_BM1690_AP
        bool "sophgo BM1690 EVB for AP mode"

    config BOARD_TYPE_SOPHGO_BM1690_TP
		select SOC_TYPE_BM1690_TP
        bool "sophgo BM1690 EVB for TP mode"
endchoice

choice
	prompt "Boot Type"
	default BOOT_TYPE_FROM_SOC

	config BOOT_TYPE_FROM_SOC
		bool "SOC mode"

	config BOOT_TYPE_FROM_PCIE
		bool "PCIe mode"
endchoice

choice BSP_ROOTFS_TYPE
    prompt "rootfs type"
    default BSP_ROOTFS_TYPE_ROMFS

    config BSP_ROOTFS_TYPE_ROMFS
        bool "ROMFS"
        select RT_USING_DFS_ROMFS

    config BSP_ROOTFS_TYPE_CROMFS
        bool "CROMFS"
        select RT_USING_DFS_CROMFS
        select PKG_USING_ZLIB
        select PKG_USING_ZLIB_LATEST_VERSION
endchoice
```

## bsp/cvitek/c920_big/board/Kconfig
```kconfig
menu "General Drivers Configuration"

    menuconfig BSP_USING_UART
        bool "Using UART"
        select RT_USING_SERIAL
        default y

        if BSP_USING_UART
            config BSP_USING_UART0
                bool "Enable UART 0"
                default y

                if BSP_USING_UART0
                    config BSP_UART0_RX_PINNAME
                        string "uart0 rx pin name"
                        default "UART0_RX"
                    config BSP_UART0_TX_PINNAME
                        string "uart0 tx pin name"
                        default "UART0_TX"
                endif

            config BSP_USING_UART1
                bool "Enable UART 1"
                default n

                if BSP_USING_UART1
                    config BSP_UART1_RX_PINNAME
                        string "uart1 rx pin name"
                        default ""
                    config BSP_UART1_TX_PINNAME
                        string "uart1 tx pin name"
                        default ""
                endif

            config BSP_USING_UART2
                bool "Enable UART 2"
                default n

                if BSP_USING_UART2
                    config BSP_UART2_RX_PINNAME
                        string "uart2 rx pin name"
                        default ""
                    config BSP_UART2_TX_PINNAME
                        string "uart2 tx pin name"
                        default ""
                endif

            config BSP_USING_UART3
                bool "Enable UART 3"
                default n

                if BSP_USING_UART3
                    config BSP_UART3_RX_PINNAME
                        string "uart3 rx pin name"
                        default ""
                    config BSP_UART3_TX_PINNAME
                        string "uart3 tx pin name"
                        default ""
                endif

            config BSP_UART_IRQ_BASE
                int
                default 41
        endif

    menuconfig BSP_USING_WDT
        bool "Enable Watchdog Timer"
        select RT_USING_WDT
        default n

        if BSP_USING_WDT
            config BSP_USING_WDT0
                bool "Enable WDT0"
                default n

            config BSP_USING_WDT1
                bool "Enable WDT1"
                default n

            config BSP_USING_WDT2
                bool "Enable WDT2"
                default n
        endif

    menuconfig BSP_USING_TIMER
        bool "Enable TIMER"
        default n
        select RT_USING_HWTIMER
        if BSP_USING_TIMER
            config BSP_USING_TIMER0
                bool "Enable TIMER0"
                default n

            config BSP_TIMER_IRQ_BASE
                int
                default 30
        endif

    config BSP_USING_RTC
        bool "Enable RTC"
        select RT_USING_RTC
        default n

    config BSP_USING_SDH
        select RT_USING_SDIO
        select RT_USING_DFS
        select RT_USING_DFS_ELMFAT
        select RT_USING_DFS_ROMFS
        bool "Enable Secure Digital Host Controller"
        default n

endmenu
```

## bsp/cvitek/c920_big/libbm1690/Kconfig
```kconfig
menu "TPU kernel lib"

    menuconfig BM1690_LIB
        bool "build libbm1690.a"
        default y

endmenu
```

## bsp/cvitek/c920_big/libbm1690/firmware_top/arch/riscv/configs/mars_defconfig
```kconfig
CONFIG_RAM_START=0x81080000
CONFIG_RAM_SIZE=0x1000000
CONFIG_ARCH_SET_TIMER_FREQ=y
CONFIG_ARCH_TIMER_FREQ=10000000

CONFIG_TARGET_ASIC=y
CONFIG_PLAT_MARS=y

CONFIG_CC_OPTIMIZE_FOR_PERFORMANCE=y

CONFIG_TEST=y
CONFIG_TEST_HELLO=y

CONFIG_DRIVER_SERIAL_NS16550=y
# CONFIG_DRIVER_IRQCHIP=y
# CONFIG_DRIVER_EFUSE=y
```

## bsp/cvitek/c920_big/libbm1690/firmware_top/drivers/serial/Kconfig
```kconfig
menu "Serial Ports"
source "drivers/serial/pl01/Kconfig"
source "drivers/serial/ns16550/Kconfig"
source "drivers/serial/tbox/Kconfig"
endmenu
```

## bsp/cvitek/c920_big/libbm1690/firmware_top/drivers/serial/tbox/Kconfig
```kconfig
config DRIVER_SERIAL_TBOX
	bool	"TBOX Serial Port Support"
	help
	tbox compatible serial port driver
```
